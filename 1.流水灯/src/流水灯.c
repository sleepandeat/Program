/*-----------------------------------------------
  文件：流水灯.c
  公司：南京爱思电子有限公司
  编写：rantg	
  日期：2012.3
  内容：P2口控制的8位LED流水显示
------------------------------------------------*/

#include<reg52.h>     

void DelayMs(unsigned int t);

/*------------------------------------------------
                    主函数
------------------------------------------------*/
void main(void)
{
	unsigned char i;                
	while(1)
	{
		P2=0xFE;                   //第1个LED亮
		for(i=0;i<8;i++)
		{
			Delay(1000);
			P2 <<=1;
		}
	
		P2=0x7F;                   //第8个LED亮
		for(i=0;i<8;i++)
		{
			Delay(1000);
			P2 >>=1;
		}
	
		P2=0xFE;                  //第1个LED亮
		for(i=0;i<8;i++)
		{
			Delay(1000);
			P2 <<=1;
			P2 |=0x01;
		}
	
		P2=0x7F;                  //第8个LED亮
		for(i=0;i<8;i++)
		{
			Delay(1000);
			P2 >>=1;
			P2 |=0x80;
		}
	}
}


/*------------------------------------------------
				 延时函数
------------------------------------------------*/
void DelayMs(unsigned int t)
{
	unsigned char i;
	for(;t > 0;t--)
		for(i = 110;i > 0;i--);
}