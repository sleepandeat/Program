/*-----------------------------------------------
名称：花样灯的实现
公司：南京爱思电子
编写：rantg
日期：2012.3
内容：通过查表法实现发光二极管花样显示
------------------------------------------------*/

#include <reg52.h>

/*------------------------------------------------
                  流水表格
------------------------------------------------*/
unsigned char code seg[]={0x7f,0xbf,0xdf,0xef,
						  0xf7,0xfb,0xfd,0xfe,
						  0xff,0xff,0x00,0x00,
						  0x55,0x55,0xaa,0xaa
						  };

void DelayMs(unsigned int t); //函数声明

/*------------------------------------------------
                    主函数
------------------------------------------------*/
void main(void)
{
	unsigned char i;   
	while(1)
	{
		for(i=0;i<16;i++)
		{
			DelayMs(1000);
			P2=seg[i];
		}
	}
}

/*------------------------------------------------
				 延时函数
------------------------------------------------*/
void DelayMs(unsigned int t)
{
	unsigned char i;
	for(;t > 0;t--)
		for(i = 110;i > 0;i--);
}